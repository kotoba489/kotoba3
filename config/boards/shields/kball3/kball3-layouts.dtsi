/ {
    kball3_layout: kball3_layout {
        compatible = "zmk,physical-layout";
        display-name = "Default Layout";
        transform = <&default_transform>;
        keys = <
            &key_physical_attrs 100 100 0 0 0 0 0
            &key_physical_attrs 100 100 100 0 0 0 0
            &key_physical_attrs 100 100 200 0 0 0 0
        >;
    };
};
